## drivers/helloworld/Kconfig
```kconfig
menu "Hello Module Kernel Support"

config HELLO_WORLD
        tristate "Hello Module Driver"
        help
          Select this option to run a Hello World Module!
endmenu
```
